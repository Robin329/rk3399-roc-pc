/*
 * DTS Demo Code
 *
 * (C) 2022.09.06 <jiangrenbin329@gmail.com>
 *
 * This program is free software; you can redistribute it and/or modify
 * it under the terms of the GNU General Public License version 2 as
 * published by the Free Software Foundation.
 */
/ {
	DTS_demo {
		compatible = "DTS_demo, QEMU-virt";
		status = "okay";
        qemu-array  = <0x10203040 0x50607080>;
        qemu-strings = "uboot", "kernel", "rootfs", "QEMU";
	};
};
